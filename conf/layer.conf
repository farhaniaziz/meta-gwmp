## conf/layer.conf
```bitbake
# We have a conf and classes directory, add to BBPATH
BBPATH .= ":${LAYERDIR}"

# We have recipes-* directories, add to BBFILES
BBFILES += "${LAYERDIR}/recipes-*/*/*.bb \
            ${LAYERDIR}/recipes-*/*/*.bbappend"

BBFILE_COLLECTIONS += "meta-gwmp"
BBFILE_PATTERN_meta-gwmp = "^${LAYERDIR}/"
BBFILE_PRIORITY_meta-gwmp = "6"

LAYERDEPENDS_meta-gwmp = "core"
LAYERSERIES_COMPAT_meta-gwmp = "warrior zeus"
```
